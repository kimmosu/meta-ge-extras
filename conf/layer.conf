## conf/layer.conf
```bitbake
# We have a conf and classes directory, append to BBPATH
BBPATH .= ":${LAYERDIR}"

# We have a recipes directory, add to BBFILES
BBFILES += "${LAYERDIR}/recipes-*/*/*.bb \
            ${LAYERDIR}/recipes-*/*/*.bbappend"

BBFILE_COLLECTIONS += "ge-extras"
BBFILE_PATTERN_ge-extras := "^${LAYERDIR}/"

# Define the priority for recipes (.bb files) from this layer,
# choosing carefully how this layer interacts with all of the
# other layers.

BBFILE_PRIORITY_ge-extras = "6"
```

## conf/machine/mx6q-b460-hwtest.conf
```bitbake
#@TYPE: Machine
#@NAME: Advantech MX6Q-B460
#@SOC: i.MX6Q
#@DESCRIPTION: Machine configuration for MX6Q-B460 HW tests
#@MAINTAINER: Kimmo Surakka <kimmo.surakka@ge.com>

# The purpose for this machine conf is simply to add
# "files/mx6q-b460-hwtest" to the search path for source files
# so we can have different kernel configuration for hardware tests.

require conf/machine/mx6q-b460.conf
```
